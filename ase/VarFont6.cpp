#include "VarFont6.h"

extern Arduboy2 arduboy;

// Variable width font: width 1 to 5 + space.  Height is 6 pixels.
// Each character uses 4 bytes of memory
// For width 5, uses bits 6&7 of each bytes 1-3 to store final column.
// Byte Bits 7&6
// 0    00       - width = 2..4
// 0    10       - width = 1 (final byte)
// 0    x1       - width 5
// 1..3 10       - final column if byte 0, bits 7&6 == 00
// 1    aa
// 2    bb
// 3    cc       - 5th column = ccbbaa if byte 0, bit 6 == 1

static const unsigned char font[] PROGMEM =
{                           // Char : Width
  0x1E, 0x21, 0x2D, 0x9D,   // @ : 4 
  0x3E, 0x09, 0xBE, 0x00,   // A : 3
  0x3F, 0x25, 0x9A, 0x00,   // B : 3 
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  0x01, 0x29, 0x86, 0x00    // ? : 3
};

VarFont6::VarFont6() {
  cursorX = cursorY = baseX = 0;
  inverse = false;
}

size_t VarFont6::write(uint8_t c) {
  if (c == '\n')      { cursorX = baseX; cursorY += LINE_HEIGHT; }
  else {
    size_t width = printChar(c, cursorX, cursorY);
    cursorX += width + LETTER_SPACING;
  }
  return 1;
}

size_t VarFont6::printChar(const char c, const int8_t x, int8_t y) {
  // Index into font (map lowercase to uppercase)
  uint8_t idx = (c & ((c < 96) ? 0x3f : 0x1f)) * 4;

  // Y offset
  uint8_t offset = y & 0x7;
  
  // Pointer into screen buffer
  uint16_t ptr = WIDTH * (y >> 3) + x;
  
  uint8_t fifthCol = 0;
  bool    useFifth = false;
  
  for (uint8_t i=0 ; i < 5; i++) {
    uint8_t data, col;
    if (i < 4) {
      data = pgm_read_byte(font + idx + i);
      col = data & 0x3f; // 6 bits
      fifthCol = (fifthCol >> 2) | (data & 0xc0); // Save upper bits
      if (i==0) {
        useFifth = (data & 0x40) == 0x40;
      }
    }
    else {
      col = fifthCol >> 2;
    }

    if (ptr < WIDTH*(HEIGHT>>3))
      if (inverse) {
        arduboy.sBuffer[ptr] &= ~(col << offset);      
      } else {
        arduboy.sBuffer[ptr] |= col << offset;
      }
    if ((offset > 1) && (ptr + 128 < WIDTH*(HEIGHT>>3))) {
      if (inverse) {
        arduboy.sBuffer[ptr+128] &= ~(col >> (8 - offset));
      } else {
        arduboy.sBuffer[ptr+128] |= col >> (8 - offset);
      } 
    }
    if (!useFifth && ((data & 0x80) == 0x80)) {
      return i+1; 
    }
    ptr++;
  }
  return 5; // max width
}

void VarFont6::setCursor(const int8_t x, const int8_t y, const bool inv) {
  cursorX = x;
  baseX = x;
  cursorY = y;
  inverse = inv;
}

void VarFont6::setInverse(const bool inv) {
  inverse = inv;
}
